## Kconfig
```kconfig
mainmenu "meta-erlang Image Configuration"

config KAS_BUILD_SYSTEM
	string
	default "openembedded"

menuconfig TESTIMAGE
        bool "Enable Testimage"
        help
          Help.

if ! IMAGES
menuconfig BEAMRUNTIME
        bool "Beamruntime"
        help
          Help.

if BEAMRUNTIME

choice
	prompt "Use OpenGL"
	default BEAMRUNTIME_WITH_OPENGL

config BEAMRUNTIME_WITH_OPENGL
	bool "Enable opengl via DISTRO_FEATURES"
	help
	  Help.

config BEAMRUNTIME_WITHOUT_OPENGL
	bool "Disable opengl via DISTRO_FEATURES"
	help
	  Help.

endchoice

choice
	prompt "TCLIB"
	default BEAMRUNTIME_WITH_TCLIB_LIBC

config BEAMRUNTIME_WITH_TCLIB_LIBC
	bool "Use libc"
	help
	  Help.

config BEAMRUNTIME_WITH_TCLIB_MUSL
	bool "Use musl"
	help
	  Help.

endchoice

config BEAMRUNTIME_REDUCED_LOCALES
        bool "Reduced locales support"
        help
          Help.

endif

endif

if ! IMAGES
menuconfig BEAMTOOLS
        bool "Beamtools"
        help
          Help.

if BEAMTOOLS

choice
	prompt "Use OpenGL"
	default BEAMTOOLS_WITH_OPENGL

config BEAMTOOLS_WITH_OPENGL
	bool "Enable opengl via DISTRO_FEATURES"
	help
	  Help.

config BEAMTOOLS_WITHOUT_OPENGL
	bool "Disable opengl via DISTRO_FEATURES"
	help
	  Help.

endchoice

endif

if BEAMTOOLS || BEAMRUNTIME

choice
        prompt "SDK Machine"
        default SDK_MACHINE_X86_64

config SDK_MACHINE_X86_64
        bool "Use x86_64 as SDKMACHINE"
        help
          Help.

config SDK_MACHINE_AARM64
        bool "Use aarm64 as SDKMACHINE"
        help
          Help.

endchoice

endif

menuconfig ERLANG_AND_ELIXIR
        bool "Erlang and Elixir"
          help
            Help.
endif

menu "Machine"

choice
	prompt "Machine"
	default MACHINE_QEMUX86_64

config MACHINE_QEMU_BSP
        bool "Use qemu-bsp machines"
        help
          Help.

config MACHINE_QEMUX86_64
	bool "Use qemux86-64"
	help
	  Help.

config MACHINE_QEMUX86_64_X32
	bool "Use qemux86-64 x32"
	help
	  Help.

config MACHINE_QEMUX86
	bool "Use qemux86"
	help
	  Help.

config MACHINE_QEMUMIPS64
	bool "Use qemumips64"
	help
	  Help.

config MACHINE_QEMURISCV64
	bool "Use qemuriscv64"
	help
	  Help.

config MACHINE_QEMURISCV32
	bool "Use qemuriscv32"
	help
	  Help.

config MACHINE_QEMUARM
	bool "Use qemuarm"
	help
	  Help.

config MACHINE_QEMUARM_64
	bool "Use qemarm-64"
	help
	  Help.

config MACHINE_QEMUARM_UBOOT
	bool "Use qemarm with uboot"
	help
	  Help.

config MACHINE_QEMUARM64_UBOOT
	bool "Use qemarm-64 with uboot"
	help
	  Help.

config MACHINE_RPI0
        bool "Use raspberrypi0-wifi"
        help
          Help.

config MACHINE_RPI4_64
        bool "Use raspberrypi4-64"
        help
          Help.

config MACHINE_RPI5
        bool "Use raspberrypi5"
        help
          Help.

endchoice

endmenu

if ! BEAMTOOLS || BEAMRUNTIME

menu "Init management system"

choice
	prompt "systemv"
	default WITH_SYSTEMD

config WITH_SYSTEMV
	bool "Use systemv"
	help
	  Help.

config WITH_SYSTEMD
	bool "Use systemd"
	help
	  Help.

endchoice

endmenu

endif

if ! IMAGES

menu "Erlang Version"

choice
	prompt "Erlang/OTP version"
	default ERLANG_MAINT_28

config ERLANG_MASTER
	bool "Use Erlang master"
	help
	  Help.

config ERLANG_MAINT_28
	bool "Use Erlang 28"
	help
	  Help.

config ERLANG_MAINT_27
	bool "Use Erlang 27"
	help
	  Help.

config ERLANG_MAINT_26
	bool "Use Erlang 26"
	help
	  Help.

config ERLANG_MAINT_25
	bool "Use Erlang 25"
	help
	  Help.

endchoice

endmenu

menu "Elixir Version"

choice
	prompt "Elixir version"
	default ELIXIR_1_18

config ELIXIR_MAIN
        bool "Use Elixir development"
        help
          Help.

config ELIXIR_1_18
        bool "Use Elixir 1.18.x"
        help
          Help.

config ELIXIR_1_17
        bool "Use Elixir 1.17.x"
        help
          Help.

config ELIXIR_1_16
        bool "Use Elixir 1.16.x"
        help
          Help.

config ELIXIR_1_15
        bool "Use Elixir 1.15.x"
        help
          Help.

config ELIXIR_1_14
        bool "Use Elixir 1.14.x"
        help
          Help.

config ELIXIR_1_13
        bool "Use Elixir 1.13.x"
        help
          Help.

endchoice
      
endmenu

endif # ! IMAGES

menuconfig IMAGES
       bool "Images"
       help
         Help.

if IMAGES

menu "Image features"

config WITH_FWUP_IMAGE
        bool "Add fwup image support"
        help
          Help.

config WITH_SIGNED_FWUP_IMAGE
        bool "Add signed fwup image support"
          help
            Help.

config TARGET_PTEST_IMAGE
        bool "Image with ptest packages"
        help
          Help.

endmenu

choice
	prompt "Images"
	default TARGET_ERLANG_ELIXIR_IMAGE

config TARGET_LOCAL_IMAGE
        bool "Local development image if Erlang and Elixir"
        help
          Help.

config TARGET_ERLANG_ELIXIR_IMAGE
        bool "Erlang and Elixir"
        help
          Help.

config TARGET_WINGS_IMAGE
        bool "wings"
        help
          Help.

config TARGET_LIVEBOOK_IMAGE
        bool "livebook"
        help
          Help.

config TARGET_RABBITMQ_IMAGE
        bool "rabbitmq"
        help
          Help.

#config TARGET_EJABBERD_IMAGE
#        bool "ejabberd"
#        help
#          Help.
#
#config KAS_TARGET_EJABBERD_IMAGE
#        string
#        depends on TARGET_EJABBERD_IMAGE
#        default "multiconfig:qemux86-64-ejabberd:core-image-minimal"
#
#config TARGET_VERNEMQ_IMAGE
#        bool "vernemq"
#        help
#          Help.
#
#config KAS_TARGET_VERNEMQ_IMAGE
#        string
#        depends on TARGET_VERNEMQ_IMAGE
#        default "multiconfig:qemux86-64-vernemq:core-image-minimal"

config TARGET_COUCHDB_IMAGE
        bool "couchdb"
        help
          Help.

config TARGET_RIAK_IMAGE
        bool "riak"
        help
          Help.

config TARGET_YAWS_IMAGE
        bool "yaws"
        help
          Help.

config TARGET_ERLANG_RED_IMAGE
        bool "Erlang-Red"
        help
          Help.

config TARGET_NERVESHUB_QEMU_IMAGE
        bool "NervesHub for QEMU based machines"
        help
          Help.

config TARGET_NERVESHUB_RPI_IMAGE
        bool "NervesHub for RPi based machines"
        help
          Help.

endchoice

endif # IMAGES

config KAS_INCLUDE_MAIN
	string
	default "base.yml"

config KAS_INCLUDE_RELEASE
	string
	default "release.yml"

config KAS_INCLUDE_MACHINE
	string
	default "qemux86-64.yml" if MACHINE_QEMUX86_64
	default "qemux86.yml" if MACHINE_QEMUX86
	default "qemumips64.yml" if MACHINE_QEMUMIPS64
	default "qemuriscv64.yml" if MACHINE_QEMURISCV64
	default "qemuriscv32.yml" if MACHINE_QEMURISCV32
	default "qemuarm.yml" if MACHINE_QEMUARM
	default "qemuarm64.yml" if MACHINE_QEMUARM_64
        default "qemux86-64-x32.yml" if MACHINE_QEMUX86_64_X32
        default "rpi0.yml" if MACHINE_RPI0
        default "rpi4-64.yml" if MACHINE_RPI4_64
        default "rpi5.yml" if MACHINE_RPI5
        default "qemu-bsp.yml" if MACHINE_QEMU_BSP
        default "qemuarm-uboot.yml" if MACHINE_QEMUARM_UBOOT
        default "qemuarm64-uboot.yml" if MACHINE_QEMUARM64_UBOOT

if ! IMAGES

config KAS_INCLUDE_ERLANG
	string
	default "erlang-maint-25.yml" if ERLANG_MAINT_25
	default "erlang-maint-26.yml" if ERLANG_MAINT_26
	default "erlang-maint-27.yml" if ERLANG_MAINT_27
	default "erlang-maint-28.yml" if ERLANG_MAINT_28
	default "erlang-master.yml" if ERLANG_MASTER

config KAS_INCLUDE_ELIXIR
	string
	default "elixir-main.yml" if ELIXIR_MAIN
	default "elixir-1.18.yml" if ELIXIR_1_18
	default "elixir-1.17.yml" if ELIXIR_1_17
	default "elixir-1.16.yml" if ELIXIR_1_16
	default "elixir-1.15.yml" if ELIXIR_1_15
	default "elixir-1.14.yml" if ELIXIR_1_14
	default "elixir-1.13.yml" if ELIXIR_1_13


endif

config KAS_INCLUDE_INIT
	string
	default "systemd.yml" if WITH_SYSTEMD
	default "systemv.yml" if WITH_SYSTEMV

if IMAGES

config KAS_INCLUDE_PTEST_IMAGE
        string
        default "core-image-minimal-ptest.yml" if TARGET_PTEST_IMAGE

config KAS_INCLUDE_LOCAL_IMAGE
        string
        default "core-image-minimal.yml" if TARGET_LOCAL_IMAGE

config KAS_INCLUDE_NERVESHUB_QEMU_IMAGE
        string
        default "nerveshub-qemu.yml" if TARGET_NERVESHUB_QEMU_IMAGE

config KAS_INCLUDE_NERVESHUB_RPI_IMAGE
        string
        default "nerveshub-rpi.yml" if TARGET_NERVESHUB_RPI_IMAGE

config KAS_INCLUDE_FWUP
        string
        default "fwup.yml" if WITH_FWUP_IMAGE

config KAS_INCLUDE_SIGNED_FWUP_IMAGE
        string
        default "fwup-signed.yml" if WITH_SIGNED_FWUP_IMAGE

config KAS_INCLUDE_ERLANG_ELIXIR
        string
        default "erlang-elixir.yml" if TARGET_ERLANG_ELIXIR_IMAGE

config KAS_INCLUDE_ERLANG_RED
        string
        default "erlang-red.yml" if TARGET_ERLANG_RED_IMAGE

config KAS_INCLUDE_RABBITMQ
        string
        default "rabbitmq.yml" if TARGET_RABBITMQ_IMAGE

config KAS_INCLUDE_COUCHDB
        string
        default "couchdb.yml" if TARGET_COUCHDB_IMAGE

config KAS_INCLUDE_RIAK
        string
        default "riak.yml" if TARGET_RIAK_IMAGE

config KAS_INCLUDE_LIVEBOOK
        string
        default "livebook.yml" if TARGET_LIVEBOOK_IMAGE

config KAS_INCLUDE_YAWS
        string
        default "yaws.yml" if TARGET_YAWS_IMAGE

config KAS_INCLUDE_WINGS
        string
        default "wings.yml" if TARGET_WINGS_IMAGE

config KAS_INCLUDE_NERVESHUB_QEMU_IMAGE
        string
        default "nerveshub-link.yml" if TARGET_NERVESHUB_QEMU_IMAGE

config KAS_INCLUDE_NERVESHUB_RPI_IMAGE
        string
        default "nerveshub-link.yml" if TARGET_NERVESHUB_RPI_IMAGE

endif

if BEAMTOOLS

config KAS_INCLUDE_BEAMTOOLS
        string
        default "beamtools.yml"

config KAS_INCLUDE_SDK_MACHINE_X86_64
        string
        default "beamtools_x86_64.yml" if SDK_MACHINE_X86_64

config KAS_INCLUDE_SDK_MACHINE_AARM64
        string
        default "beamtools_aarm64.yml" if SDK_MACHINE_AARM64

config KAS_INCLUDE_BEAMTOOLS_WITH_OPENGL
	string
	default "beamtools_opengl.yml" if BEAMTOOLS_WITH_OPENGL

config KAS_INCLUDE_BEAMTOOLS_WITHOUT_OPENGL
	string
	default "beamtools_no_opengl.yml" if BEAMTOOLS_WITHOUT_OPENGL

endif

if BEAMRUNTIME

config KAS_INCLUDE_BEAMRUNTIME
        string
        default "beamruntime.yml"

config KAS_INCLUDE_SDK_MACHINE_X86_64
        string
        default "beamtools_x86_64.yml" if SDK_MACHINE_X86_64

config KAS_INCLUDE_SDK_MACHINE_AARM64
        string
        default "beamtools_aarm64.yml" if SDK_MACHINE_AARM64

config KAS_INCLUDE_BEAMRUNTIME_WITH_OPENGL
	string
	default "beamtools_opengl.yml" if BEAMRUNTIME_WITH_OPENGL

config KAS_INCLUDE_BEAMRUNTIME_WITHOUT_OPENGL
	string
	default "beamtools_no_opengl.yml" if BEAMRUNTIME_WITHOUT_OPENGL

config KAS_INCLUDE_BEAMRUNTIME_REDUCED_LOCALES
        string
        default "locales.yml" if BEAMRUNTIME_REDUCED_LOCALES

config KAS_INCLUDE_BEAMRUNTIME_WITH_TCLIB_MUSL
        string
        default "tclib_musl.yml" if BEAMRUNTIME_WITH_TCLIB_MUSL

endif

if TESTIMAGE

config KAS_INCLUDE_TESTIMAGE
        string
        default "testimage.yml"

endif

if ERLANG_AND_ELIXIR

config KAS_INCLUDE_ERLANG_AND_ELIXIR
        string
        default "meta-erlang.yml"

endif
```
